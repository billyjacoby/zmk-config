## config/west.yml
```yaml
manifest:
  defaults:
    revision: v0.3
  remotes:
    - name: zmkfirmware
      url-base: https://github.com/zmkfirmware
    - name: billyjacoby
      url-base: https://github.com/billyjacoby
    - name: petejohanson
      url-base: https://github.com/petejohanson/
    - name: caksoylar
      url-base: https://github.com/caksoylar
    - name: geeksville
      url-base: https://github.com/geeksville
  projects:
    - name: zmk
      remote: billyjacoby
      revision: toucan-kscan-suppression
      import: app/west.yml
    - name: cirque-input-module
      remote: billyjacoby
      revision: toucan-circular-scroll
    - name: zmk-rgbled-widget
      remote: caksoylar
      revision: v0.3
  self:
    path: config
```

## modules/zmk-input-processor-layer-scroll/Kconfig
```kconfig
menuconfig ZMK_INPUT_PROCESSOR_LAYER_SCROLL
    bool "Layer Scroll Input Processor"
    help
        Transforms trackball movement to scroll events when on specified layers.

if ZMK_INPUT_PROCESSOR_LAYER_SCROLL

module = ZMK_INPUT_PROCESSOR_LAYER_SCROLL
module-str = layer_scroll
source "${ZEPHYR_BASE}/subsys/logging/Kconfig.template.log_config"

endif
```

## modules/zmk-input-processor-layer-scroll/dts/bindings/input/zmk,input-processor-layer-scroll.yaml
```yaml
description: |
  Layer Scroll Input Processor
  Transforms pointing device movement to scroll events when on specified layers.

compatible: "zmk,input-processor-layer-scroll"

include: input-processor.yaml

properties:
  layers:
    type: array
    required: true
    description: Layer numbers that trigger scroll mode
```
